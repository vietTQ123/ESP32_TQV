#include <Adafruit_GFX.h>
#include <Adafruit_ST7735.h>
#include <MAX30100_PulseOximeter.h>
#include <Fonts/DSEG7_Classic_Mini_Bold_25.h>
#include <Fonts/SFProText_Semibold12pt7b.h>
#include <SPI.h>
#include <Wire.h>

#define TFT_CS 10
#define TFT_RST 12
#define TFT_DC 8
#define TFT_SCK 13
#define TFT_MOSI 11

#define REPORTING_PERIOD_MS 1000

Adafruit_ST7735 tft = Adafruit_ST7735(TFT_CS, TFT_DC, TFT_RST);

PulseOximeter pox;

uint32_t tsLastReport = 0;

int heart_new=1;
int heart_old=1;
int spo2_new=1;
int spo2_old=1;

const unsigned short heart[1024] PROGMEM = {
    0x0000, 0x0000, 0x0000, 0x0000, 0x0000, 0x0000, 0x0000, 0x0000, 0x0000, 0x0000, 0x0000, 0x0000, 0x0000, 0x0000, 0x0000, 0x0000, // 0x0010 (16) pixels
    0x0000, 0x0000, 0x0000, 0x0000, 0x0000, 0x0000, 0x0000, 0x0000, 0x0000, 0x0000, 0x0000, 0x0000, 0x0000, 0x0000, 0x0000, 0x0000, // 0x0020 (32) pixels
    0x0000, 0x0000, 0x0000, 0x0000, 0x0000, 0x0000, 0xFAAA, 0xFAEB, 0xFACB, 0xFACB, 0xFAEB, 0xFAAA, 0x0000, 0x0000, 0x0000, 0x0000, // 0x0030 (48) pixels
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    0x0000, 0x0000, 0x0000, 0x0000, 0x0000, 0x0000, 0x0000, 0x0000, 0x0000, 0x0000, 0x0000, 0x0000, 0x0000, 0x0000, 0x0000, 0x0000, // 0x0400 (1024) pixels
};

void setup()
{
  tft.initR(INITR_BLACKTAB);
  tft.fillScreen(ST7735_WHITE);
  tft.setRotation(3);

  Serial.begin(9600);

  Serial.print("Initializing pulse oximeter..");

  if (!pox.begin())
  {
    Serial.println("FAILED");
    for (;;)
      ;
  }
  else
  {
    Serial.println("SUCCESS");
  }

  pox.setIRLedCurrent(MAX30100_LED_CURR_7_6MA);
}

void loop()
{
  tft.setFont(&SFProText_Semibold12pt7b);

  tft.setCursor(5, 30);
  tft.setTextColor(ST7735_RED);
  tft.setTextSize(1);
  tft.println("HEART");

  tft.setCursor(5, 90);
  tft.setTextColor(ST7735_BLUE);
  tft.setTextSize(1);
  tft.println("SPO2");

  pox.update();

  if (millis() - tsLastReport > REPORTING_PERIOD_MS)
  {
    Serial.print("Heart BPM:");
    Serial.print(pox.getHeartRate());
    Serial.print("-----");
    Serial.print("Oxygen Percent:");
    Serial.print(pox.getSpO2());
    Serial.println("\n");

    heart_new=pox.getHeartRate();
    spo2_new=pox.getSpO2();

    tft.setFont(&DSEG7_Classic_Mini_Bold_25);

    if(heart_new != heart_old)
    {
      tft.fillRect(5,35,110,37,ST7735_WHITE);

      heart_old =heart_new;
    }

    tft.setCursor(5, 65);
    tft.setTextColor(ST7735_BLACK);
    tft.setTextSize(1);
    tft.println(pox.getHeartRate());

    if(spo2_new != spo2_old)
    {
      tft.fillRect(5,95,110,35,ST7735_WHITE);

      spo2_old = spo2_new;
    }

    tft.setCursor(5, 123);
    tft.setTextColor(ST7735_BLACK);
    tft.setTextSize(1);
    tft.println(pox.getSpO2());

    tsLastReport = millis();
  }
}
